## Documentation/devicetree/bindings/staging/mitx_bmc.txt
```
* T-platforms mitx bmc driver

Required properties:
- compatible: Should be "tp,mitx2-bmc"
- reg: i2c bus address of the device

Example:

	bmc@8 {
		compatible = "tp,mitx2-bmc";
		reg = <0x08>;
	};
```

## arch/mips/baikal/Kconfig
```kconfig
#
# Baikal-T SOC platform support code.
#
# Copyright (C) 2014-2016 Baikal Electronics JSC
#
# Author:
#   Dmitry Dunaev <dmitry.dunaev@baikalelectronics.ru>
#
# This program is free software; you can redistribute it and/or
# modify it under the terms of the GNU General Public License
# as published by the Free Software Foundation; either version 2
# of the License, or (at your option) any later version.
#
# This program is distributed in the hope that it will be useful,
# but WITHOUT ANY WARRANTY; without even the implied warranty of
# MERCHANTABILITY or FITNESS FOR A PARTICULAR PURPOSE.  See the
# GNU General Public License for more details.
#

if MIPS_BAIKAL

choice
	prompt "Baikal CPU Support"
	default MIPS_BAIKAL_T

config MIPS_BAIKAL_T
	bool "BAIKAL-T MIPS CPU"
	select OF_EARLY_FLATTREE
	select GENERIC_SCHED_CLOCK
	select NO_IOPORT
	select SOC_BUS
	help
	  Early version of Baikal-T (MIPS32 P5600) SoC based systems

config MIPS_BAIKAL_T1
	bool "BAIKAL-T1 MIPS CPU"
	select OF_EARLY_FLATTREE
	select GENERIC_SCHED_CLOCK
	select NO_IOPORT
	select SOC_BUS
	help
	  Baikal-T1 (MIPS32 P5600) SoC based systems (newer version)

endchoice


config BAIKAL_T_COMMON
	bool "Baikal-T common features"

	# Hardware features
	select HW_HAS_PCI
	select HW_PERF_EVENTS

	# Common
	select PHYLIB
	select DEBUG_LL
	select TIMER_GENERIC
	select ARCH_WANT_OPTIONAL_GPIOLIB
	select SYS_HAS_CPU_MIPS32_R5

	# HW perfomance counters
	select HAVE_PERF_EVENTS
	select PERF_EVENTS
	select HW_PERF_EVENTS

	# Clock source
	select COMMON_CLK_BAIKAL

	# Serial UART
	select SERIAL_8250
	select SERIAL_8250_CONSOLE
	select SERIAL_8250_EXTENDED
	select SERIAL_8250_DW

	# WatchDog
	select DW_WATCHDOG

	# Timers
	select CLKSRC_OF
	select DW_APB_TIMER
	select DW_APB_TIMER_OF

	# I2C Bus support
	select I2C_DESIGNWARE_CORE
	select I2C_DESIGNWARE_PLATFORM

	# GPIO support
	select GPIOLIB
	select OF_GPIO
	select GPIO_SYSFS
	select GPIO_DWAPB
	select GPIO_GENERIC

	# Gigabit Ethernet support
	select STMMAC_ETH
	select STMMAC_PLATFORM
	select STMMAC_DEBUG_FS

	# SPI bus support
	select SPI_DESIGNWARE
	select SPI_DW_MMIO

	# USB Support
	select USB_DWC3
	select USB_DWC3_HOST
	select USB_DWC3_BAIKAL
	select USB_PHY

	help
	  Common features of Baikal-T based boards

choice
	prompt "Baikal-T Support Boards"
	default MACH_BAIKAL_BFK

config MACH_BAIKAL_BFK
	bool "Baikal-T BFK board"

	select MIPS_BAIKAL_T
	select BAIKAL_T_COMMON

	# Errata set
	select PAGE_SIZE_16KB

	# DTB select
	select DTB_BAIKAL_BFK

config MACH_BAIKAL_BFK2
	bool "Baikal-T BFK2 board"

	select MIPS_BAIKAL_T1
	select BAIKAL_T_COMMON

	# Errata set
	select PAGE_SIZE_16KB

	# DTB select
	select DTB_BAIKAL_BFK2

config MACH_BAIKAL_MITX
	bool "Baikal-T mITX board"

	select MIPS_BAIKAL_T1
	select BAIKAL_T_COMMON

	# Errata set
	select PAGE_SIZE_16KB

	# DTB select
	select DTB_BAIKAL_MITX

	# PCIe
	select PCI_DRIVERS_GENERIC

config MACH_BAIKAL_MODULE
	bool "Baikal-T Module board"

	select MIPS_BAIKAL_T
	select BAIKAL_T_COMMON

	# Errata set
	select PAGE_SIZE_16KB

	# DTB select
	select DTB_BAIKAL_MODULE

	# PCIe
	select PCI_DRIVERS_GENERIC

config MACH_BAIKAL_MSBT2
	bool "Baikal-T MSBT2 board"

	select MIPS_BAIKAL_T1
	select BAIKAL_T_COMMON

	# Errata set
	select PAGE_SIZE_16KB

	# DTB select
	select DTB_BAIKAL_MSBT2

	# PCIe
	select PCI_DRIVERS_GENERIC

config MACH_BAIKAL_RT1MB
	bool "Baikal-T RT1MB board"

	select MIPS_BAIKAL_T1
	select BAIKAL_T_COMMON

	# Errata set
	select PAGE_SIZE_16KB

	# DTB select
	select DTB_TP_RT1MB

	# PCIe
	select PCI_DRIVERS_GENERIC

config MACH_BAIKAL_QEMU
	bool "Baikal-T QEMU simulator"

	select MIPS_BAIKAL_T1
	select BAIKAL_T_COMMON

	# Errata set
	select PAGE_SIZE_16KB

	# DTB select
	select DTB_BAIKAL_QEMU

config MACH_BAIKAL_FPGA
	bool "Baikal-T FPGA board"

	select MIPS_BAIKAL_T

	# Errata set
	select PAGE_SIZE_16KB

	# Common
	select DEBUG_LL
	select TIMER_GENERIC

	# Serial UART
	select SERIAL_8250
	select SERIAL_8250_CONSOLE
	select SERIAL_8250_EXTENDED
	select SERIAL_8250_DW

	# Timers
	select CLKSRC_OF
	select DW_APB_TIMER
	select DW_APB_TIMER_OF

	# DTB select
	select DTB_BAIKAL_FPGA

endchoice

choice
        prompt "Baikal Board configs"
        default DTB_BAIKAL

config DTB_BAIKAL
	bool "Baikal-T generic board"
	help
	  Generic device tree for common boards
	  based on Baikal-T SOC family. Contains
	  only devices included in basic SOC
	  configuration.

config DTB_BAIKAL_BFK
	bool "Baikal-T BFK board"
	help
	  Device tree for BFK boards (for versions 1.0, 1.5, 1.6)
	  based on Baikal-T SOC.

config DTB_BAIKAL_BFK2
	bool "Baikal-T BFK2 board"
	help
	  Device tree for BFK2 boards (for versions 2.x)
	  based on Baikal-T SOC.

config DTB_BAIKAL_MODULE
	bool "Baikal-T 'Module' board"
	help
	  Device tree for Baikal-T 'Module' board.
	  Common device configuration.

config DTB_BAIKAL_QEMU
	bool "Baikal-T QEMU simulator"
	help
	  Device tree for QEMU simulator.

config DTB_BAIKAL_FPGA
	bool "Baikal-T FPGA board"
	help
	  Device tree for Baikal-T FPGA prototype.
	  Simple device configuration.

	help
	  Select device tree for Baikal-T SOC based board

config DTB_BAIKAL_MITX
	bool "Baikal-T MITX board"
	help
	  Device tree for T-Platforms mITX boards
	  based on Baikal-T SOC.

config DTB_BAIKAL_MSBT2
	bool "Baikal-T MSBT2 board"
	help
	  Device tree for T-Platforms MSBT2 boards
	  based on Baikal-T SOC.

config DTB_TP_RT1MB
	bool "T-Platforms RT1MB board"
	help
	  Device tree for T-Platforms RT1MB board
	  based on Baikal-T1 SOC.

endchoice

config ARCH_NR_GPIO
	int "Baikal GPIOs plus architecture specific ones"
	range 32 512
	default 40 if MACH_BAIKAL_BFK
	default 40 if MACH_BAIKAL_BFK2
	default 40 if MACH_BAIKAL_MITX
	default 48 if MACH_BAIKAL_MODULE
	default 48 if MACH_BAIKAL_MSBT2
	default 32
	help
	  Maximum number of GPIOs in the system.

	  If unsure, leave the default value.

config MIPS_BAIKAL_PCI_DMA
	bool "PCI DMA support"
	default n

menuconfig BAIKAL_ERRATA
	bool "Baikal SoC Errata Fix"
	help
	  Select this option if you want to fix known Baikal Errata

if BAIKAL_ERRATA

config BAIKAL_ERRATA_XGMAC
	bool "Fix for MMD Devices in package registers swap in XGMAC"
	help
	  Fix for MMD Devices in package registers swap in XGMAC in
	  early Baikal-T SoCs

	  If unsure, say Y.

config BAIKAL_ERRATA_GMAC
	bool "Fix for GMAC block speed 10/100M"
	help
	  Fix for GMAC block speed 10/100M in early Baikal-T SoCs

	  If unsure, say N.

config BAIKAL_ERRATA_GBE_PHY_MICREL
	bool "Fix for Micrel PHY RX delay on BFK board"
	help
	  Fix for Micrel PHY RX delay on early revisions of BFK board (v1.0)

	  If unsure, say N.

endif # BAIKAL_ERRATA
endif # MIPS_BAIKAL

config SYS_HAS_CPU_MIPS32_R5
	bool
	default n
```

## arch/mips/configs/baikal_fpga_defconfig
```kconfig
CONFIG_MIPS_BAIKAL=y
CONFIG_MACH_BAIKAL_FPGA=y
CONFIG_CPU_MIPS32_3_5_FEATURES=y
CONFIG_PAGE_SIZE_16KB=y
CONFIG_MIPS_CPS=y
CONFIG_NR_CPUS=2
CONFIG_HZ_100=y
CONFIG_LOCALVERSION="-fpga"
CONFIG_DEFAULT_HOSTNAME="baikal"
CONFIG_FHANDLE=y
CONFIG_NO_HZ_IDLE=y
CONFIG_HIGH_RES_TIMERS=y
CONFIG_LOG_CPU_MAX_BUF_SHIFT=17
CONFIG_NAMESPACES=y
CONFIG_BLK_DEV_INITRD=y
CONFIG_INITRAMFS_SOURCE="../../img/initramfs.gz"
CONFIG_CC_OPTIMIZE_FOR_SIZE=y
CONFIG_EMBEDDED=y
CONFIG_SLAB=y
CONFIG_UEVENT_HELPER_PATH="/sbin/hotplug"
CONFIG_DEVTMPFS=y
CONFIG_DEVTMPFS_MOUNT=y
CONFIG_DEBUG_DRIVER=y
CONFIG_DEBUG_DEVRES=y
CONFIG_SERIAL_8250_NR_UARTS=2
CONFIG_SERIAL_8250_RUNTIME_UARTS=2
# CONFIG_IOMMU_SUPPORT is not set
CONFIG_PROC_KCORE=y
CONFIG_TMPFS=y
CONFIG_TMPFS_POSIX_ACL=y
CONFIG_PRINTK_TIME=y
CONFIG_DYNAMIC_DEBUG=y
CONFIG_DEBUG_INFO=y
CONFIG_DEBUG_FS=y
CONFIG_DEBUG_SECTION_MISMATCH=y
CONFIG_DEBUG_MEMORY_INIT=y
CONFIG_LOCKUP_DETECTOR=y
CONFIG_BOOTPARAM_SOFTLOCKUP_PANIC=y
CONFIG_DEBUG_WW_MUTEX_SLOWPATH=y
CONFIG_PROVE_LOCKING=y
CONFIG_LOCK_STAT=y
CONFIG_DEBUG_LOCKDEP=y
CONFIG_DEBUG_ATOMIC_SLEEP=y
CONFIG_SPARSE_RCU_POINTER=y
```
